/*
 * Copyright (c) 2022 The ZMK Contributors
 *
 * SPDX-License-Identifier: MIT
 */

#include "matrix-transform.dtsi"

/ {
  chosen {
    zmk,kscan = &kscan0;
    zmk,physical-layout = &default_layout;
  };

  kscan0: kscan_0 {
    compatible = "zmk,kscan-gpio-matrix";
    wakeup-source;

    diode-direction = "col2row";
        row-gpios
            = <&xiao_d 0 (GPIO_ACTIVE_HIGH | GPIO_PULL_DOWN)>
            , <&xiao_d 1 (GPIO_ACTIVE_HIGH | GPIO_PULL_DOWN)>
            , <&xiao_d 2 (GPIO_ACTIVE_HIGH | GPIO_PULL_DOWN)>
            , <&xiao_d 3 (GPIO_ACTIVE_HIGH | GPIO_PULL_DOWN)>
            ;
  };
};
